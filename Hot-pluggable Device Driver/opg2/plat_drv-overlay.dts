// Definitions for plat_drv-overlay module
/dts-v1/;
/plugin/;

/ {
  compatible = "brcm,bcm2835", "brcm,bcm2836", "brcm,bcm2708", "brcm,bcm2709";

  fragment@0 {
    /* Add device to base */
    target-path = "/";
    __overlay__ {
      /* instance:type */
      plat_drv: plat_drv@0 {
        /* Opdater "compatible" til den ønskede værdi */
        compatible = "ase, plat_drv";

        gpios = <&gpio 12 0>, <&gpio 16 0>, <&gpio 20 1>, <&gpio 21 1>, <&gpio 26 1> ;

        plat_drv-custom = <0x12345678>;
        status = "okay";
      };
    };
  };
};
