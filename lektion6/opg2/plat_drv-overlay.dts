// Definitions for plat_drv-overlay module
/dts-v1/;
/plugin/;

/ {
  compatible = "brcm,bcm2835", "brcm,bcm2836", "brcm,bcm2708", "brcm,bcm2709";

  fragment@0 {
    /* Add device to base */
    target-path = "/";
    __overlay__ {
      /* instance:type */
      plat_drv_overlay: plat_drv-overlay@0 {
        /* Opdater "compatible" til den ønskede værdi */
        compatible = "ase, plat_drv";
        status = "okay";
      };
    };
  };
};
